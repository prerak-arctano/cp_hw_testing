## boards/Arctano/nrf54l15_arctano/Kconfig.nrf54l15_arctano
```kconfig
config BOARD_NRF54L15_ARCTANO
	select SOC_NRF54L15_CPUAPP if BOARD_NRF54L15_ARCTANO_NRF54L15_CPUAPP
	select SOC_NRF54L15_CPUFLPR if \
		BOARD_NRF54L15_ARCTANO_NRF54L15_CPUFLPR || \
		BOARD_NRF54L15_ARCTANO_NRF54L15_CPUFLPR_XIP
```

## boards/Arctano/nrf54l15_arctano/board.yml
```yaml
board:
  name: nrf54l15_arctano
  full_name: Arctano nRF54L15
  vendor: arctano
  socs:
    - name: nrf54l15
      variants:
        - name: xip
          cpucluster: cpuflpr
runners:
  run_once:
    '--recover':
      - runners:
          - nrfjprog
          - nrfutil
        run: first
        groups:
          - boards:
              - nrf54l15_arctano/nrf54l15/cpuapp
              - nrf54l15_arctano/nrf54l15/cpuflpr
              - nrf54l15_arctano/nrf54l15/cpuflpr/xip
    '--erase':
      - runners:
          - nrfjprog
          - jlink
          - nrfutil
        run: first
        groups:
          - boards:
              - nrf54l15_arctano/nrf54l15/cpuapp
              - nrf54l15_arctano/nrf54l15/cpuflpr
              - nrf54l15_arctano/nrf54l15/cpuflpr/xip
    '--reset':
      - runners:
          - nrfjprog
          - jlink
          - nrfutil
        run: last
        groups:
          - boards:
              - nrf54l15_arctano/nrf54l15/cpuapp
              - nrf54l15_arctano/nrf54l15/cpuflpr
              - nrf54l15_arctano/nrf54l15/cpuflpr/xip
```
